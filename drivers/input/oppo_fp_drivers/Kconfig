## drivers/input/oppo_fp_drivers/Kconfig
```kconfig
menuconfig OPPO_FINGERPRINT
	bool "OPLUS fingerprint"
	depends on SPI_MASTER
	help
	  Say Y here to enable OPLUS fingerprint support.

if OPPO_FINGERPRINT

config OPPO_FINGERPRINT_MTK
	bool "Fingerprint on MediaTek platforms"
	default y

config OPPO_FINGERPRINT_FPC
	bool "FPC capacitive fingerprint sensors (TEE)"
	depends on OPPO_FINGERPRINT_MTK

config OPPO_FINGERPRINT_GOODIX
	bool "Goodix capacitive fingerprint sensors (TEE)"
	depends on OPPO_FINGERPRINT_MTK && TRUSTONIC_TEE_SUPPORT

endif # OPPO_FINGERPRINT
```

## drivers/misc/mediatek/adsp/Kconfig
```kconfig
config MTK_AUDIODSP_SUPPORT
	bool "Specifiy If Platform Support Audio dsp"
	default n
	select MTK_AUDIO_IPI
	help
	  AUDIO_DSP is a MediaTek in-house DSP which can do
	  different audio process.
	  Set Y to enable this feature.
	  If unsure,
	  Set N to stay with legancy feature.

config MTK_AUDIODSP_LEGACY
	bool "Compat with legacy audio firmware/blobs"
	default n
	depends on MTK_AUDIODSP_SUPPORT
	help
	  Enable this option if your device uses older audio firmware/blobs.

	  If unsure, say N.

config MTK_AUDIODSP_LEGACY_R
	bool "Compat with Android R audio firmware/blobs"
	default n
	depends on MTK_AUDIODSP_LEGACY
	help
	  Enable this option if your device uses Android R audio DSP
	  firmware and audio HAL. These predate the FM, sub phone call and
	  BLE audio task scenes, so the driver controller scenes follow
	  the capture raw scene directly.

	  If unsure, say N.
```

## drivers/misc/mediatek/boot/Kconfig
```kconfig
config MTK_BOOT
	bool "Enable MTK Boot information API"
	depends on OF
	help
	  Provide the boot mode API declared in mt-plat/mtk_boot_common.h
	  (get_boot_mode(), get_boot_type(), is_meta_mode() and
	  is_advanced_meta_mode()), based on the atag,boot property LK
	  passes in /chosen. Say Y for platforms whose drivers use it.
```

## drivers/misc/mediatek/camera_ldo/Kconfig
```kconfig
config CAMERA_LDO
	bool "WL2864C camera LDO"
	depends on I2C
	help
	  Driver for the WL2864C seven channel camera LDO on I2C
	  (mediatek,i2c_camera_ldo) with its enable GPIO
	  (mediatek,gpio_camera_ldo), used by the imgsensor power
	  sequences of the realme nemo family.
```

## drivers/misc/mediatek/ccu/src/Kconfig
```kconfig
config MTK_CCU
	tristate "MediaTek CCU Driver"
	help
	  Support 3A using CCU hardware
	  Offers speed up of 3A, including
	  Faster control flow and
	  Stabler frame rate.

config MTK_CCU_R_ABI
	bool "Use the Android R CCU driver on MT6785"
	depends on MTK_CCU && MACH_MT6785
	help
	  Build the MT6785 CCU driver of the Android R (kernel 4.14)
	  release instead of the IPC based one. R 3A HALs
	  (lib3a.ccudrv) drive /dev/ccu with the command queue ioctls
	  (ENQUE/DEQUE/FLUSH_COMMAND, CCU_IOCTL_SET_RUN as _IO(c, 11),
	  SET_WORK_BUF) and load the CCU firmware themselves; the 4.19
	  driver replaced these with SET_RUN_INPUT, LOAD_CCU_BIN and
	  IPC_* ioctls.
```

## drivers/misc/mediatek/imgsensor/Kconfig
```kconfig
config MTK_IMGSENSOR
	bool CONFIG_MTK_IMGSENSOR
	default n
	help
	  Kernel space image sensor driver. Define  project used all image
	  sensors .The value is combination of CUSTOM_KERNEL_MAIN_IMGSENSOR,
	  CUSTOM_KERNEL_MAIN_BACKUP_IMGSENSOR, CUSTOM_KERNEL_SUB_IMGSENSOR,
	  and CUSTOM_KERNEL_SUB_BACKUP_IMGSENSOR

config MTK_IMGSENSOR_R_ABI
	bool "Keep the Android R imgsensor userspace ABI"
	depends on MTK_IMGSENSOR
	help
	  Camera HALs built against the Android R (kernel 4.14) imgsensor
	  headers know 10 sensor scenarios (up to CUSTOM5) and 8 virtual
	  channel infos and have no per-exposure PDAF virtual channel
	  types. Kernel 4.19 extended these to 20 scenarios and 9 VC infos,
	  which changes the size of ACDK_SENSOR_INFO_STRUCT (216 -> 296),
	  ACDK_SENSOR_RESOLUTION_INFO_STRUCT (108 -> 148),
	  SET_PD_BLOCK_INFO_T and SENSOR_VC_INFO2_STRUCT and the value of
	  the VC feature types. Say Y here when running such a HAL.

config OPLUS_IMGSENSOR
	bool "oplus imgsensor extensions"
	depends on MTK_IMGSENSOR
	depends on OPLUS_FEATURE_OPROJECT && OPPO_DEVICE_IFNO
	help
	  oplus feature control IDs used by oplus camera HALs
	  (module SN/info, EEPROM data at 0x8000/0x9000), the per-project
	  sensor list, power sequence and hardware configuration selected
	  at runtime from the oplus project number, and the camera module
	  entries in /proc/devinfo.

source "drivers/misc/mediatek/imgsensor/src/Kconfig"
```

## drivers/misc/mediatek/sensors-1.0/oppo_sensor_devinfo/Kconfig
```kconfig
config OPLUS_FEATURE_SENSOR
	bool "OPLUS sensor hub extensions"
	depends on CUSTOM_KERNEL_SENSORHUB && NANOHUB && OF_FLATTREE
	help
	  Support the oplus additions to the SCP sensor hub: sensor
	  device info and factory calibration handling (loaded from the
	  oppo_custom partition and pushed to the SCP), the private
	  firmware requests, and the /proc/oplusSensorFeature and
	  /proc/sensor nodes and calibration interfaces used by the
	  oplus vendor sensor HAL and libraries.
```

## drivers/misc/mediatek/sensors-1.0/oppo_virtual_sensor/Kconfig
```kconfig
config OPLUS_FEATURE_SENSOR_ALGORITHM
	bool "OPLUS algorithm sensors"
	depends on OPLUS_FEATURE_SENSOR
	help
	  Support the oplus algorithm sensors computed by the SCP firmware
	  (camera protect, free fall, pick up, fingerprint display, lux
	  AOD, pedometer minute, touch gesture...). This extends the hub
	  sensor type table with types 73-83 and their event payloads,
	  as used by the oplus firmware.

if OPLUS_FEATURE_SENSOR_ALGORITHM

config OPLUS_FEATURE_CAMERA_PROTECT
	bool "Camera protect sensor"

config OPLUS_FEATURE_FREE_FALL
	bool "Free fall sensor"

config OPLUS_FEATURE_PICKUP_DETECT
	bool "Pick up detect sensor"

config OPLUS_FEATURE_FP_DISPLAY
	bool "Fingerprint display sensor"

config OPLUS_FEATURE_LUX_AOD
	bool "Lux AOD sensor"

config OPLUS_FEATURE_PEDO_MINUTE
	bool "Pedometer minute sensor"

config OPLUS_FEATURE_TP_GESTURE
	bool "Touch gesture sensor"

endif
```

## drivers/nfc/nq330-i2c/Kconfig
```kconfig
config NFC_PN553_DEVICES
	bool "NXP NQ3xx (PN553 family) NCI protocol driver (I2C) devices"
	depends on I2C && OPPO_NFC
	help
	  Character device driver (/dev/pn553) for NXP NQ310/NQ330 NFC
	  controllers, used by the NXP NFC HAL. Probes only when the
	  project's NFC chipset (OPPO_NFC) is one of them.
```

## drivers/power/oplus/Kconfig
```kconfig
# SPDX-License-Identifier: GPL-2.0-only

menuconfig OPLUS_CHARGER
	bool "OPLUS charging system"
	depends on I2C
	select REGMAP_I2C
	help
	  Say Y here to enable the OPLUS charging framework: the charging
	  state machine, the battery/usb/ac power supplies it registers,
	  the external fuel gauge and the VOOC fast charging MCU drivers.

if OPLUS_CHARGER

config OPLUS_CHARGER_MTK
	bool "OPLUS charger on MTK"
	depends on MTK_CHARGER
	help
	  Say Y here to declare that the OPLUS charging framework runs on
	  a MediaTek platform on top of the MediaTek charger class.

config OPLUS_CHARGER_MTK6785
	bool "OPLUS charger glue for MT6785 with MT6360"
	depends on OPLUS_CHARGER_MTK && MACH_MT6785
	depends on MT6360_PMU_CHARGER && TCPC_CLASS
	select MTK_DISABLE_GAUGE
	help
	  Say Y here to replace the MediaTek charger manager with the OPLUS
	  MT6785 glue, which drives the MT6360 charger (and the MP2650
	  charger with the DA9313 divider on SuperVOOC boards) for the
	  OPLUS charging framework.

	  The battery is measured by an external BQ27541 gauge, so the
	  MediaTek Gauge Master 3.0 and its battery power supply are
	  disabled.

endif # OPLUS_CHARGER
```

## drivers/soc/oplus/Kconfig
```kconfig
# SPDX-License-Identifier: GPL-2.0
menu "OPLUS SoC drivers"

config OPLUS_FEATURE_OPROJECT
	bool "OPLUS project info"
	depends on OF
	help
	  Exposes the project, PCB, operator and engineering versions
	  passed by the bootloader in the oplus_project device tree node
	  under /proc/oppoVersion, and to other drivers through
	  get_project() and friends.

config OPPO_DEVICE_IFNO
	bool "OPLUS device info"
	depends on OPLUS_FEATURE_OPROJECT
	help
	  Provides /proc/devinfo, where drivers register the name and
	  vendor of the hardware components they detected.

config OPPO_NFC
	bool "OPLUS NFC chipset info"
	depends on OPLUS_FEATURE_OPROJECT
	help
	  Exposes the NFC chipset fitted to this project/operator variant,
	  as described by the oppo-nfc-chipset device tree node, through
	  /proc/oppo_nfc/chipset.

endmenu
```
